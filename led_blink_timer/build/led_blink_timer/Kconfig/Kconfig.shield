## led_blink_timer/build/led_blink_timer/Kconfig/Kconfig.shield
```kconfig
osource "D:/GitHub/led_timer_blink/led_blink_timer/boards/shields/*/Kconfig.shield"
osource "D:/ncs/v2.9.0/nrf/boards/shields/*/Kconfig.shield"
```

## led_blink_timer/build/led_blink_timer/Kconfig/Kconfig.shield.defconfig
```kconfig
osource "D:/GitHub/led_timer_blink/led_blink_timer/boards/shields/*/Kconfig.defconfig"
osource "D:/ncs/v2.9.0/nrf/boards/shields/*/Kconfig.defconfig"
```
