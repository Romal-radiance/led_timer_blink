## led_blink_timer/build/Kconfig/boards/Kconfig.defconfig
```kconfig
# Load Zephyr board defconfig descriptions.
osource "D:/ncs/v2.9.0/zephyr/boards/nordic/nrf52840dk/Kconfig.defconfig"
```

## led_blink_timer/build/led_blink_timer/Kconfig/boards/Kconfig
```kconfig
# Load Zephyr board Kconfig descriptions.
osource "D:/ncs/v2.9.0/zephyr/boards/nordic/nrf52840dk/Kconfig"
```
